## meta-evb/meta-evb-aspeed/meta-mars/conf/layer.conf
```bitbake
# We have a conf and classes directory, add to BBPATH
BBPATH .= ":${LAYERDIR}"

# We have recipes-* directories, add to BBFILES
BBFILES += "${LAYERDIR}/recipes-*/*/*.bb \
            ${LAYERDIR}/recipes-*/*/*.bbappend"

BBFILE_COLLECTIONS += "mars"
BBFILE_PATTERN_mars = "^${LAYERDIR}/"
BBFILE_PRIORITY_mars = "7"

LAYERDEPENDS_meta-mars = "core"
LAYERSERIES_COMPAT_meta-mars = "gatesgarth"
```

## meta-evb/meta-evb-aspeed/meta-mars/conf/machine/evb-mars.conf
```bitbake
KERNEL_DEVICETREE = "aspeed-ast2600-evb.dtb"
UBOOT_MACHINE = "ast2600_openbmc_spl_emmc_defconfig"
UBOOT_DEVICETREE = "ast2600a1-evb"

require conf/machine/include/ast2600.inc
require conf/distro/include/phosphor-mmc.inc


PREFERRED_PROVIDER_self-hosted-debug= "packagegroup-self-hosted-debug"
SERIAL_CONSOLES = "115200;ttyS4"

WKS_FILE = "emmc.wks.in"

SOCSEC_SIGN_ENABLE = "0"
SPL_BINARY = "spl/u-boot-spl.bin"
SPL_SIGN_ENABLE = "1"
UBOOT_FIT_GENERATE_KEYS = "1"
SOCSEC_SIGN_EXTRA_OPTS = "--stack_intersects_verification_region=false"
SOCSEC_SIGN_KEY ?= "${WORKDIR}/rsa_oem_dss_key.pem"
UBOOT_SIGN_ENABLE = "1"
UBOOT_FITIMAGE_ENABLE = "1"
FIT_HASH_ALG = "sha512"
FIT_SIGN_ALG = "rsa4096"
UBOOT_FIT_HASH_ALG = "sha512"
UBOOT_FIT_SIGN_ALG = "rsa4096"
UBOOT_FIT_SIGN_NUMBITS = "4096"
UBOOT_SIGN_KEYNAME = "rsa_oem_fitimage_key"
SPL_SIGN_KEYNAME = "rsa_oem_fitimage_key"
UBOOT_SIGN_KEYDIR = "${WORKDIR}"
SPL_SIGN_KEYDIR = "${WORKDIR}"


IMAGE_FEATURES:append = " nfs-client"
OBMC_MACHINE_FEATURES:append = "obmc-phosphor-system-mgmt obmc-phosphor-chassis-mgmt "
PREFERRED_PROVIDER_virtual/obmc-system-mgmt = "packagegroup-mars-apps"
PREFERRED_PROVIDER_virtual/obmc-chassis-mgmt = "packagegroup-mars-apps"

OVERRIDES .= ":mars"
```
